## west.yml
```yaml
# Frozen from local checkout 2026-10-09; uncloned optional projects retain upstream pinned SHAs.
manifest:
  group-filter:
  - -babblesim
  - -optional
  - -testing
  projects:
  - name: zephyr
    url: https://github.com/zephyrproject-rtos/zephyr
    revision: 894020886d647a5f9b8a58bdf2cb8c211a62716b
    west-commands: scripts/west-commands.yml
  - name: tflite-micro
    url: https://github.com/zephyrproject-rtos/tflite-micro
    revision: 43b2a106a391dd8a099ac47f2ae858630a397264
    path: optional/modules/lib/tflite-micro
    groups:
    - optional
  - name: zephyr-lang-rust
    url: https://github.com/zephyrproject-rtos/zephyr-lang-rust
    revision: dd73abc242e995784da62352fe8c70d9a6c7ac2e
    path: modules/lang/rust
    groups:
    - optional
  - name: acpica
    url: https://github.com/zephyrproject-rtos/acpica
    revision: 8d24867bc9c9d81c81eeac59391cda59333affd4
    path: modules/lib/acpica
  - name: babblesim_base
    url: https://github.com/BabbleSim/base
    revision: 68baf150660213d67c29acb14bf9fccecf4612eb
    path: tools/bsim/components
    groups:
    - babblesim
  - name: babblesim_ext_2G4_channel_NtNcable
    url: https://github.com/BabbleSim/ext_2G4_channel_NtNcable
    revision: 20a38c997f507b0aa53817aab3d73a462fff7af1
    path: tools/bsim/components/ext_2G4_channel_NtNcable
    groups:
    - babblesim
  - name: babblesim_ext_2G4_channel_multiatt
    url: https://github.com/BabbleSim/ext_2G4_channel_multiatt
    revision: bde72a57384dde7a4310bcf3843469401be93074
    path: tools/bsim/components/ext_2G4_channel_multiatt
    groups:
    - babblesim
  - name: babblesim_ext_2G4_device_WLAN_actmod
    url: https://github.com/BabbleSim/ext_2G4_device_WLAN_actmod
    revision: 9cb6d8e72695f6b785e57443f0629a18069d6ce4
    path: tools/bsim/components/ext_2G4_device_WLAN_actmod
    groups:
    - babblesim
  - name: babblesim_ext_2G4_device_burst_interferer
    url: https://github.com/BabbleSim/ext_2G4_device_burst_interferer
    revision: 5b5339351d6e6a2368c686c734dc8b2fc65698fc
    path: tools/bsim/components/ext_2G4_device_burst_interferer
    groups:
    - babblesim
  - name: babblesim_ext_2G4_device_playback
    url: https://github.com/BabbleSim/ext_2G4_device_playback
    revision: abb48cd71ddd4e2a9022f4bf49b2712524c483e8
    path: tools/bsim/components/ext_2G4_device_playback
    groups:
    - babblesim
  - name: babblesim_ext_2G4_libPhyComv1
    url: https://github.com/BabbleSim/ext_2G4_libPhyComv1
    revision: 27eb408f952182a646eac1abb7dc12b7b565655b
    path: tools/bsim/components/ext_2G4_libPhyComv1
    groups:
    - babblesim
  - name: babblesim_ext_2G4_modem_BLE_simple
    url: https://github.com/BabbleSim/ext_2G4_modem_BLE_simple
    revision: 6fdae81d5b5e348bd130c038d049b233ce983a74
    path: tools/bsim/components/ext_2G4_modem_BLE_simple
    groups:
    - babblesim
  - name: babblesim_ext_2G4_modem_magic
    url: https://github.com/BabbleSim/ext_2G4_modem_magic
    revision: d8281acb634895c8a769489c27146bdfe1a54938
    path: tools/bsim/components/ext_2G4_modem_magic
    groups:
    - babblesim
  - name: babblesim_ext_2G4_phy_v1
    url: https://github.com/BabbleSim/ext_2G4_phy_v1
    revision: b0e49ae3dd4d6d0f2286fd1392cee1b5206f5bbc
    path: tools/bsim/components/ext_2G4_phy_v1
    groups:
    - babblesim
  - name: babblesim_ext_libCryptov1
    url: https://github.com/BabbleSim/ext_libCryptov1
    revision: da246018ebe031e4fe4a8228187fb459e9f3b2fa
    path: tools/bsim/components/ext_libCryptov1
    groups:
    - babblesim
  - name: bsim
    url: https://github.com/zephyrproject-rtos/babblesim-manifest
    revision: 0673623452f0a3cb50b7563c32ac7683304cb6fc
    path: tools/bsim
    groups:
    - babblesim
  - name: cmsis
    url: https://github.com/zephyrproject-rtos/cmsis
    revision: 512cc7e895e8491696b61f7ba8066b4a182569b8
    path: modules/hal/cmsis
    groups:
    - hal
  - name: cmsis-dsp
    url: https://github.com/zephyrproject-rtos/cmsis-dsp
    revision: 45d23287f5b41be49612281a5e7c802c6a415388
    path: modules/lib/cmsis-dsp
  - name: cmsis-nn
    url: https://github.com/zephyrproject-rtos/cmsis-nn
    revision: 73591f72850bfebe95c6f30f6e75a773abb711cd
    path: modules/lib/cmsis-nn
  - name: cmsis_6
    url: https://github.com/zephyrproject-rtos/CMSIS_6
    revision: 1c1840af7a7e757d6e2fec3ddb0e5ce0dfcc93c8
    path: modules/hal/cmsis_6
    groups:
    - hal
  - name: dhara
    url: https://github.com/zephyrproject-rtos/dhara
    revision: 6f163ca05e174b168b4d148160b50eeaeeb561fc
    path: modules/lib/dhara
  - name: edtt
    url: https://github.com/zephyrproject-rtos/edtt
    revision: c282625e694f0b53ea53e13231ea6d2f49411768
    path: tools/edtt
    groups:
    - tools
  - name: fatfs
    url: https://github.com/zephyrproject-rtos/fatfs
    revision: 4f60a12c58c3de4246857ad87c40239ecd93349b
    path: modules/fs/fatfs
    groups:
    - fs
  - name: hal_adi
    url: https://github.com/zephyrproject-rtos/hal_adi
    revision: 489885cdfa668870f95b00ded1cc56ac52cdf5c4
    path: modules/hal/adi
    groups:
    - hal
  - name: hal_afbr
    url: https://github.com/zephyrproject-rtos/hal_afbr
    revision: 1abf6947457380934e27f92508ec5532ddedfc6d
    path: modules/hal/afbr
    groups:
    - hal
  - name: hal_ambiq
    url: https://github.com/zephyrproject-rtos/hal_ambiq
    revision: 3d7044ea240fc8dcb7b4c843b76f70cae5db736b
    path: modules/hal/ambiq
    groups:
    - hal
  - name: hal_atmel
    url: https://github.com/zephyrproject-rtos/hal_atmel
    revision: 8f95c79f2a80427ef446563cc9addefa959e92a9
    path: modules/hal/atmel
    groups:
    - hal
  - name: hal_bouffalolab
    url: https://github.com/zephyrproject-rtos/hal_bouffalolab
    revision: 577b219696191f7715ac772e265b14108ecc49a5
    path: modules/hal/bouffalolab
    groups:
    - hal
  - name: hal_espressif
    url: https://github.com/zephyrproject-rtos/hal_espressif
    revision: b16851b3c20e6fad3d2da42ec24a3e82d0b8b444
    path: modules/hal/espressif
    west-commands: west/west-commands.yml
    groups:
    - hal
  - name: hal_ethos_u
    url: https://github.com/zephyrproject-rtos/hal_ethos_u
    revision: 03567073fe2b9802c0bd73f9534da6f8a03924d1
    path: modules/hal/ethos_u
    groups:
    - hal
  - name: hal_gigadevice
    url: https://github.com/zephyrproject-rtos/hal_gigadevice
    revision: 804f92bf5794e403fab89178dcc6d775b9269c0d
    path: modules/hal/gigadevice
    groups:
    - hal
  - name: hal_infineon
    url: https://github.com/zephyrproject-rtos/hal_infineon
    revision: 2191db4d7723737ffd3d59d01b50f7595dac2944
    path: modules/hal/infineon
    groups:
    - hal
  - name: hal_intel
    url: https://github.com/zephyrproject-rtos/hal_intel
    revision: 884c7a79a48efef50bc0d12c86f5d0951748f24d
    path: modules/hal/intel
    groups:
    - hal
  - name: hal_microchip
    url: https://github.com/zephyrproject-rtos/hal_microchip
    revision: e33b6fce18d8a75dad23a2af6dd2d027564fee89
    path: modules/hal/microchip
    groups:
    - hal
  - name: hal_nordic
    url: https://github.com/zephyrproject-rtos/hal_nordic
    revision: c708b9fe1b7a36090c468374811a6e934b97e54a
    path: modules/hal/nordic
    groups:
    - hal
  - name: hal_nuvoton
    url: https://github.com/zephyrproject-rtos/hal_nuvoton
    revision: 0f411a85da7d17a612d54450f608f4d30cdb971f
    path: modules/hal/nuvoton
    groups:
    - hal
  - name: hal_nxp
    url: https://github.com/zephyrproject-rtos/hal_nxp
    revision: a2e2237465e4d5d6d21b30dbbe365a78eccc241a
    path: modules/hal/nxp
    groups:
    - hal
  - name: hal_openisa
    url: https://github.com/zephyrproject-rtos/hal_openisa
    revision: eabd530a64d71de91d907bad257cd61aacf607bc
    path: modules/hal/openisa
    groups:
    - hal
  - name: hal_quicklogic
    url: https://github.com/zephyrproject-rtos/hal_quicklogic
    revision: bad894440fe72c814864798c8e3a76d13edffb6c
    path: modules/hal/quicklogic
    groups:
    - hal
  - name: hal_realtek
    url: https://github.com/zephyrproject-rtos/hal_realtek
    revision: 29d365ccfbceb9f42ce666d75463fbe2c83b8e29
    path: modules/hal/realtek
    west-commands: west/west-commands.yml
    groups:
    - hal
  - name: hal_renesas
    url: https://github.com/zephyrproject-rtos/hal_renesas
    revision: 55d5b9e0341b8dc7612fca4e2f13d6086984709a
    path: modules/hal/renesas
    groups:
    - hal
  - name: hal_rpi_pico
    url: https://github.com/zephyrproject-rtos/hal_rpi_pico
    revision: 2e9dbf14fa56e5907aefb07e8e75010ec5210946
    path: modules/hal/rpi_pico
    groups:
    - hal
  - name: hal_sifli
    url: https://github.com/zephyrproject-rtos/hal_sifli
    revision: 86fa0e9433fda1a760e0077c19b8407ecceea2f9
    path: modules/hal/sifli
    groups:
    - hal
  - name: hal_silabs
    url: https://github.com/zephyrproject-rtos/hal_silabs
    revision: ca5f98ea5588fd6aefcb03cb6ea9898ed90ecf15
    path: modules/hal/silabs
    groups:
    - hal
  - name: hal_st
    url: https://github.com/zephyrproject-rtos/hal_st
    revision: ce795a9b0de623022c17d2ff394587c024aec850
    path: modules/hal/st
    groups:
    - hal
  - name: hal_stm32
    url: https://github.com/zephyrproject-rtos/hal_stm32
    revision: c9550199186236d610092f4005f8c9bae2a6bfcf
    path: modules/hal/stm32
    groups:
    - hal
  - name: hal_tdk
    url: https://github.com/zephyrproject-rtos/hal_tdk
    revision: 4e53fe1a1ea634dd8a13ecda1151a73bc598622f
    path: modules/hal/tdk
    groups:
    - hal
  - name: hal_telink
    url: https://github.com/zephyrproject-rtos/hal_telink
    revision: 4226c7fc17d5a34e557d026d428fc766191a0800
    path: modules/hal/telink
    groups:
    - hal
  - name: hal_ti
    url: https://github.com/zephyrproject-rtos/hal_ti
    revision: 53c80140dd69905cc5e034f637eff9c66b2f9654
    path: modules/hal/ti
    groups:
    - hal
  - name: hal_wch
    url: https://github.com/zephyrproject-rtos/hal_wch
    revision: fbfabfc590e86b74af873bd26d3b4433a0ffb9e9
    path: modules/hal/wch
    groups:
    - hal
  - name: hal_wurthelektronik
    url: https://github.com/zephyrproject-rtos/hal_wurthelektronik
    revision: 7c1297ea071d03289112eb24e789c89c7095c0a2
    path: modules/hal/wurthelektronik
    groups:
    - hal
  - name: hal_xtensa
    url: https://github.com/zephyrproject-rtos/hal_xtensa
    revision: 60224c27bed1466287f0246ac04c902b92331c29
    path: modules/hal/xtensa
    groups:
    - hal
  - name: hostap
    url: https://github.com/zephyrproject-rtos/hostap
    revision: 1c541a0913058912376bb832fb753161978c266b
    path: modules/lib/hostap
  - name: liblc3
    url: https://github.com/zephyrproject-rtos/liblc3
    revision: 48bbd3eacd36e99a57317a0a4867002e0b09e183
    path: modules/lib/liblc3
  - name: libmctp
    url: https://github.com/zephyrproject-rtos/libmctp
    revision: b6be45dfc5c67c43c3a5e12589ae3845ea00ab5e
    path: modules/lib/libmctp
  - name: libmetal
    url: https://github.com/zephyrproject-rtos/libmetal
    revision: 77237e9748212796a8f93a33689ce935fb9c81c2
    path: modules/hal/libmetal
    groups:
    - hal
  - name: libsbc
    url: https://github.com/zephyrproject-rtos/libsbc
    revision: 8e1beda02acb8972e29e6edbb423f7cafe16e445
    path: modules/lib/libsbc
  - name: littlefs
    url: https://github.com/zephyrproject-rtos/littlefs
    revision: e9a8638fc228e43a3156ed3ac602229af3e3c1d5
    path: modules/fs/littlefs
    groups:
    - fs
  - name: lora-basics-modem
    url: https://github.com/zephyrproject-rtos/lora-basics-modem
    revision: a8ddc544043e72807cf7db532478e1dda734ae7c
    path: modules/lib/lora-basics-modem
  - name: loramac-node
    url: https://github.com/zephyrproject-rtos/loramac-node
    revision: 874544f2a8a0212a0cc12e5eea51a024fd3d93d1
    path: modules/lib/loramac-node
  - name: lvgl
    url: https://github.com/zephyrproject-rtos/lvgl
    revision: d1fe35d350a1503db2ec7fd4dfff8e0cc26eea7e
    path: modules/lib/gui/lvgl
  - name: mbedtls
    url: https://github.com/zephyrproject-rtos/mbedtls
    revision: c43f34b93797e81fd0257c30004dcd0ae332ae51
    path: modules/crypto/mbedtls
    groups:
    - crypto
  - name: mcuboot
    url: https://github.com/zephyrproject-rtos/mcuboot
    revision: a8ffd2c312910cc648219bcb29e04260f7857492
    path: bootloader/mcuboot
    groups:
    - bootloader
  - name: mipi-sys-t
    url: https://github.com/zephyrproject-rtos/mipi-sys-t
    revision: 5a9d6055b62edc54566d6d0034d9daec91749b98
    path: modules/debug/mipi-sys-t
    groups:
    - debug
  - name: mldsa-native
    url: https://github.com/zephyrproject-rtos/mldsa-native
    revision: 3fc19982839305d305071f0de0c540bc9c9bea8a
    path: modules/crypto/mldsa-native
    groups:
    - crypto
  - name: nanopb
    url: https://github.com/zephyrproject-rtos/nanopb
    revision: 0f6d088e777a33dd7b54297f137ef10d745c5da8
    path: modules/lib/nanopb
  - name: net-tools
    url: https://github.com/zephyrproject-rtos/net-tools
    revision: 96ecb88c982812d48564d319cf7d9a0709c85c70
    path: tools/net-tools
    groups:
    - tools
  - name: nrf_hw_models
    url: https://github.com/zephyrproject-rtos/nrf_hw_models
    revision: 50187f3879ffaafc171d364490bead27557f5192
    path: modules/bsim_hw_models/nrf_hw_models
  - name: nrf_wifi
    url: https://github.com/zephyrproject-rtos/nrf_wifi
    revision: fc0872109ec4c006d32843a202b129db33cf16b9
    path: modules/lib/nrf_wifi
  - name: open-amp
    url: https://github.com/zephyrproject-rtos/open-amp
    revision: 01032a8a7bdfdd541686f5dfa3671e602b9fcbff
    path: modules/lib/open-amp
  - name: openthread
    url: https://github.com/zephyrproject-rtos/openthread
    revision: 4a8d33459567cc611bf9d4d810c2201a24a64d84
    path: modules/lib/openthread
  - name: percepio
    url: https://github.com/zephyrproject-rtos/percepio
    revision: 022c06f76d3e141aad98252fa9211665bf8ca027
    path: modules/debug/percepio
    groups:
    - debug
  - name: picolibc
    url: https://github.com/zephyrproject-rtos/picolibc
    revision: 01254932e8e81085817ed61fd858648584ffe37c
    path: modules/lib/picolibc
  - name: psa-arch-tests
    url: https://github.com/zephyrproject-rtos/psa-arch-tests
    revision: 3ce2420dd321c86928b40d33a8f799f5138469d3
    path: modules/tee/tf-m/psa-arch-tests
    groups:
    - testing
    - tee
  - name: reqmgmt
    url: https://github.com/zephyrproject-rtos/reqmgmt
    revision: c6803e9b4e9bf9ae7fad3c7cd85dbf35d0d09ede
    path: doc/reqmgmt
  - name: segger
    url: https://github.com/zephyrproject-rtos/segger
    revision: 50892fdbcf2f570e67baa72b8894a66b16946f72
    path: modules/debug/segger
    groups:
    - debug
  - name: tf-m-tests
    url: https://github.com/zephyrproject-rtos/tf-m-tests
    revision: 420c95daa7a25143bb88f807a1e2c432dd4372e8
    path: modules/tee/tf-m/tf-m-tests
    groups:
    - testing
    - tee
  - name: tf-psa-crypto
    url: https://github.com/zephyrproject-rtos/tf-psa-crypto
    revision: 765af96a20a2b408474dcd950372ba9af4d26b62
    path: modules/crypto/tf-psa-crypto
    groups:
    - crypto
  - name: trusted-firmware-a
    url: https://github.com/zephyrproject-rtos/trusted-firmware-a
    revision: 4d431cbbb451d13359534c63bf67e2d315ca37de
    path: modules/tee/tf-a/trusted-firmware-a
    groups:
    - tee
  - name: trusted-firmware-m
    url: https://github.com/zephyrproject-rtos/trusted-firmware-m
    revision: b01f190e46afcb02b7f240d2b3ab961d6bca6c24
    path: modules/tee/tf-m/trusted-firmware-m
    groups:
    - tee
  - name: uoscore-uedhoc
    url: https://github.com/zephyrproject-rtos/uoscore-uedhoc
    revision: dc0ab6345450668de3f9597320a48c5a2d409bb6
    path: modules/lib/uoscore-uedhoc
  - name: zcbor
    url: https://github.com/zephyrproject-rtos/zcbor
    revision: 9164bd18dcd88ff9d9ef98279501fc1093571017
    path: modules/lib/zcbor
  - name: zephyr-xenlib
    url: https://github.com/zephyrproject-rtos/zephyr-xenlib
    revision: 8b13d0b709314b7de6cb5877c286d52e71095cc8
    path: modules/lib/zephyr-xenlib
  self:
    path: .
```
